## Documentation/devicetree/bindings/mfd/fsl,qixis-i2c.yaml
```yaml
# SPDX-License-Identifier: (GPL-2.0-only OR BSD-2-Clause)
%YAML 1.2
---
$id: http://devicetree.org/schemas/mfd/fsl,qixis-i2c.yaml#
$schema: http://devicetree.org/meta-schemas/core.yaml#

title: NXP's QIXIS CPLD board management controller

maintainers:
  - Ioana Ciornei <ioana.ciornei@nxp.com>

description: |
  The board management controller found on some Layerscape boards contains
  different IP blocks like GPIO controllers, interrupt controllers, reg-muxes
  etc.

properties:
  compatible:
    enum:
      - fsl,lx2160a-qds-qixis-i2c
      - fsl,lx2162a-qds-qixis-i2c
      - fsl,ls1028a-qds-qixis-i2c

  reg:
    description:
      I2C device address.
    maxItems: 1

  "#address-cells":
    const: 1

  "#size-cells":
    const: 0

  mux-controller:
    $ref: /schemas/mux/reg-mux.yaml#

required:
  - "#address-cells"
  - "#size-cells"
  - compatible
  - reg

additionalProperties: false

examples:
  - |
    i2c {
        #address-cells = <1>;
        #size-cells = <0>;

        qixis@66 {
            compatible = "fsl,lx2160a-qds-qixis-i2c";
            reg = <0x66>;
            #address-cells = <1>;
            #size-cells = <0>;

            mux: mux-controller {
                compatible = "reg-mux";
                #mux-control-cells = <1>;
                mux-reg-masks = <0x54 0xf8>, /* 0: reg 0x54, bits 7:3 */
                                <0x54 0x07>; /* 1: reg 0x54, bit 2:0 */
            };
        };
    };
```
